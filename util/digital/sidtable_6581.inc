
!byte $9f,$9f,$9f,$9f,$9f,$9f,$9f,$9f,$9f,$9f,$9f,$9f,$9f,$9f,$9f,$9f
!byte $9f,$9f,$9f,$9e,$9e,$9e,$9e,$9e,$9d,$9d,$9d,$9d,$9d,$9d,$9c,$9c
!byte $9c,$9c,$9c,$9c,$9b,$9b,$9b,$9b,$9b,$dc,$dc,$9a,$9a,$9a,$9a,$db
!byte $99,$99,$99,$99,$99,$99,$da,$98,$98,$98,$98,$98,$d9,$ba,$ba,$97
!byte $97,$97,$97,$97,$97,$97,$97,$d7,$d7,$96,$96,$96,$96,$d6,$d6,$d6
!byte $95,$95,$95,$95,$95,$d5,$d5,$d5,$94,$94,$94,$94,$b5,$d4,$d4,$d4
!byte $b4,$b4,$93,$93,$f4,$d3,$d3,$b3,$b3,$b3,$92,$92,$92,$d2,$d2,$b2
!byte $b2,$f2,$f2,$91,$91,$91,$d1,$b1,$f1,$f1,$12,$51,$51,$71,$90,$30
!byte $00,$a1,$a2,$a3,$a4,$a4,$a5,$41,$61,$21,$21,$01,$01,$42,$42,$42
!byte $62,$62,$22,$22,$22,$22,$43,$43,$63,$63,$63,$23,$23,$23,$23,$44
!byte $64,$64,$64,$45,$45,$45,$24,$24,$24,$24,$65,$46,$46,$46,$46,$25
!byte $25,$25,$47,$47,$47,$67,$67,$26,$26,$26,$26,$48,$48,$48,$68,$68
!byte $27,$27,$27,$49,$49,$69,$69,$4a,$4a,$4a,$4a,$28,$28,$28,$28,$4b
!byte $4b,$6b,$29,$29,$29,$29,$29,$6c,$6c,$2a,$2a,$2a,$2a,$2a,$2a,$4e
!byte $4e,$2b,$2b,$2b,$2b,$2b,$2b,$2c,$2c,$2c,$2c,$2c,$2c,$2c,$2d,$2d
!byte $2d,$2d,$2d,$2d,$2d,$2e,$2e,$2e,$2e,$2e,$2e,$0e,$2f,$2f,$2f,$2f
