!byte $9f,$9f,$df,$df,$df,$df,$df,$9e,$9e,$9e,$9e,$9e,$de,$de,$de,$de
!byte $de,$9d,$9d,$9d,$9d,$9d,$9d,$dd,$dd,$dd,$dd,$dd,$9c,$9c,$9c,$9c
!byte $9c,$dc,$dc,$dc,$dc,$dc,$9b,$9b,$9b,$9b,$9b,$9b,$db,$db,$db,$db
!byte $db,$9a,$9a,$9a,$9a,$9a,$da,$da,$da,$da,$da,$99,$99,$99,$99,$99
!byte $99,$d9,$d9,$d9,$d9,$d9,$98,$98,$98,$98,$98,$d8,$d8,$d8,$d8,$d8
!byte $d8,$3f,$3f,$3f,$3f,$97,$97,$97,$d7,$d7,$3e,$3e,$7e,$7e,$7e,$3d
!byte $3d,$7d,$7d,$7d,$3c,$3c,$7c,$7c,$7c,$3b,$3b,$7b,$7b,$7b,$3a,$3a
!byte $7a,$7a,$7a,$39,$39,$39,$79,$79,$18,$18,$58,$58,$58,$78,$17,$17
!byte $37,$57,$77,$16,$16,$16,$56,$56,$56,$15,$15,$55,$55,$55,$14,$14
!byte $14,$54,$54,$13,$13,$13,$53,$53,$53,$12,$12,$12,$52,$52,$11,$11
!byte $11,$51,$51,$f0,$90,$80,$80,$80,$80,$01,$01,$01,$41,$41,$41,$02
!byte $02,$42,$42,$42,$03,$03,$03,$03,$43,$43,$04,$04,$04,$04,$44,$44
!byte $44,$05,$05,$05,$45,$45,$06,$06,$06,$06,$46,$46,$07,$07,$07,$07
!byte $47,$47,$47,$28,$08,$08,$08,$48,$48,$29,$09,$09,$09,$49,$49,$0a
!byte $0a,$0a,$0a,$4a,$4a,$0b,$0b,$0b,$4b,$4b,$4b,$2c,$0c,$0c,$0c,$4c
!byte $4c,$2d,$0d,$0d,$4d,$4d,$4d,$2e,$0e,$0e,$4e,$4e,$4e,$2f,$0f,$0f

